## components/led_strip/Kconfig
```kconfig
menu "LED strip RMT Configuration"

config WS2812_NUM_LEDS
    int "Number of LEDs in the WS2812 strip."
    default 8
    help
	Specify the number of LEDs that will be controlled through the component. Keep in mind that for every LED in the strip an RGB value needs to be stored in a buffer.

config WS2812_LED_RMT_TX_CHANNEL
	int "RMT Channel that will be used to modulate the signal."
	default 0
	help
	Defines that RMT Channel that will be used to modulate the signal. Valid values are defined by enum rmt_channel_t (0-7)

config WS2812_LED_RMT_TX_GPIO
	int "GPIO number where the WS2812 strip is connected."
    default 18
    help
	Specify which GPIO should be used to send the signal. Only Output pins can be used: 0-5 or 12-33 should be ok.
endmenu
```

## main/Kconfig.projbuild
```kconfig
menu "Spot Check Configuration"
    config CONFIGURATION_ACCESS_POINT_SSID
        string "Configuation AP SSID"
        default "Spot Check configuration"
        help
            SSID of the configuration network that users connect to to provision device

    config DISABLE_OTA
        bool "Disable OTA updates"
        default false
        help
            Flag to indicate whether or not this FW should reach out to OTA_URL to check for FW update. Overrides all other OTA settings

    config OTA_URL
        string "OTA URL"
        default "https://192.168.1.242:8070/blink.bin"
        help
            URL to check for firmware updates on startup

    config OTA_CHECK_INTERVAL_HOURS
        int "OTA interval"
        default 6
        help
            Number of hours to wait in between checks for available OTA update

    choice BOARD_REVISION
        prompt "Board revision / type"
        default ESP32_DEVBOARD
        help
            The board revision / type to compile for

        config SPOT_CHECK_REV_3_1
            bool "Spot Check rev 3.1"

        config SPOT_CHECK_REV_2
            bool "Spot Check rev 2"

        config ESP32_DEVBOARD
            bool "ESP32 dev board"
    endchoice

    config MEMFAULT_PROJECT_KEY
        string "Memfault project key"
        help
            Project key generated from valid Memfault account
endmenu
```
